## drivers/input/touchscreen/ilitek/Kconfig
```kconfig
choice
        depends on TOUCHSCREEN_NWD_ILITEK
        prompt  "touchscreen parameter select"

config YINGLONG_ZHENGJI_1024600
       bool "yinglong zhengji 1024*600 touchcreen"

config YINGLONG_ZHENGJI_FOCUS_1024600
       bool "yinglong zhengji focus 1024*600 touchcreen"

config YINGLONG_YUANCHEPIN_800480
       bool "yinglong es250 yuan che ping sheng ji 800*480 touchcreen"

config YINGLONG_YUANCHEPIN_NX300_800480
       bool "yinglong NX300 yuan che ping sheng ji 800*480 touchcreen"

config YINGLONG_ZHENGJI_963A_1024600
       bool "yinglong zhengji 963A 1024*600 touchcreen"

endchoice
```

## drivers/input/touchscreen/nwd-gt9xx/Kconfig
```kconfig
choice
        depends on TOUCHSCREEN_NWD_GT9XX 
        prompt  "touchscreen parameter select"

config QIWEN_8INCH_GT911_A
       bool "qiwen 8inch panel 1024x480 touchcreen"

config QIWEN_BENZ
       bool "qiwen BENZ panel 1024x600 touchcreen"

config QIWEN_BWM3
       bool "qiwen BMW3 panel 1280x480 touchcreen"

config HUALINGAN_YCP 
       bool "hualingan 8inch panel 1024x600 touchcreen"

config HUALINGAN_YCP_9INCH
       bool "hualingan 9inch panel 1024x600 touchcreen benzcls"

config ZHUOYI_BMW 
       bool "zhuoyi 1280x600 touchcreen"

config ZHUOYI_BMW_3li
       bool "zhuoyi 1280x480 touchcreen"

config KEWEI_9INCH_GT911_KEY3
       bool "kewei 10.1inch with key 3 panel 1024x600 touchcreen"

config YOUYANG_8INCH_GT911
       bool "youyang ture is aiying 8inch panel 1024x600 touchcreen"

config HUABAO_DANGDINGJI_6INCH_GT911
       bool "hua bao 6inch panel/pnd 800*480 touchcreen"

config HANGSHENG_10INCH_GT928
       bool "hangsheng 10inch panel 1024x600 touchcreen"

config HAOBANGSHOU_8INCH_GT911
       bool "haobangshou(jiangchuang) 8inch panel 1024600 touchcreen"

config YOUYANG_BAOLAI_10INCH_GT911
       bool "youyang tuguan 10inch panel 1024600 touchcreen"

config FEIYIN_10INCH_GT928
       bool "feiyin zhongchu 10inch panel 1024600 touchcreen"

config YINZHIYUAN_10INCH_GT928
       bool "yinzhiyuan 10inch panel 1024600 touchcreen"

config YINZHIYUAN_8INCH_GT928
       bool "yinzhiyuan 8inch panel 1024600 touchcreen"

config HANGSHENG_10INCH_GT928
       bool "hangsheng tuguan 10inch panel 1024600 touchcreen"

config SUOLING_ES250_10INCH_GT928
       bool "suoling es250 8inch panel 800480 touchcreen"

config SUOLING_ADQ3_8INCH_GT928
       bool "suoling AudiQ3 8inch panel 1024600 touchcreen"

config BEIJIAN_10INCH_GT928
       bool "beijian 10inch panel 1024600touchcreen"

config MAIXIN_10INCH_GT928
       bool "maixin 10inch panel 1024600 touchcreen"

config SHLL_10INCH_GT928
       bool "sheng hang le lu 10inch panel 1024600 touchcreen"

config JILI_HONGJING
       bool "jili hongjing(xiongmao) 10inch panel 1024768 touchcreen"

config HEXIN_BMW
       bool "hexin panel 1024487 touchcreen"

config HEXIN_BMW320
       bool "hexinBMW320 panel 1280480 touchcreen"

config HEXIN_BMW520
       bool "hexinBMW520 zhongpei panel 1280600 touchcreen"

config HEXIN_BMW520_ZC
       bool "hexinBMW520 zhongchu panel 1280600 touchcreen"

config YLZJ_10INCH_GT928
       bool "yinglong zhengji escort(furuisi) 1024*600 touchcreen"

config PENGHUI_BMW
       bool "penghui panel 1024480 touchcreen"

config BEIHANG_BENZ
       bool "beihang benz panel 1024600 touchcreen"

config BEIHANG_ADQ3
       bool "beihang AudiQ3 7inch panel 1024600 touchcreen"

config SUOLING_BENZ
       bool "suoing benzc200 panel 1024600 touchcreen base on beihang/hualingan benz"

config SUOLING_BENZ_GLK
       bool "suoing benz_glk panel 1024600 touchcreen"

endchoice
```

## drivers/input_d200/touchscreen/ilitek/Kconfig
```kconfig
choice
        depends on TOUCHSCREEN_NWD_ILITEK
        prompt  "touchscreen parameter select"

config YINGLONG_ZHENGJI_1024600
       bool "yinglong zhengji 1024*600 touchcreen"


config YINGLONG_YUANCHEPIN_800480
       bool "yinglong yuan che ping sheng ji 800*480 touchcreen"
endchoice
```

## drivers/input_d200/touchscreen/nwd-gt9xx/Kconfig
```kconfig
choice
        depends on TOUCHSCREEN_NWD_GT9XX 
        prompt  "touchscreen parameter select"

config PENGHUI_9INCH_ZHONGCHU_GT911
       bool "penghui 9inch 1024*600touchcreen"

config PENGHUI_8INCH_ZHONGCHU_GT911
       bool "penghui 8inch 1024*600 touchcreen"

config QIWEN_8INCH_GT911 
       bool "qiwen 8inch 1024*600 touchcreen"

config QIWEN_8INCH_GT911_A
       bool "qiwen 8inch panel 1024x480 touchcreen"

config KEWEI_9INCH_GT911_KEY1
       bool "kewei 9inch with key 1 panel 1024x600 touchcreen"

config KEWEI_9INCH_GT911_KEY2
       bool "kewei 9inch with key 2 panel 1024x600 touchcreen"

config KEWEI_9INCH_GT911_KEY3
       bool "kewei 10.1inch with key 3 panel 1024x600 touchcreen"

config YOUYANG_8INCH_GT911
       bool "youyang 8inch panel 1024x600 touchcreen"

config HUABAO_DANGDINGJI_6INCH_GT911
       bool "hua bao 6inch panel/pnd 800*480 touchcreen"

config HANGSHENG_10INCH_GT928
       bool "hangsheng 10inch panel 1024x600 touchcreen"

config HAOBANGSHOU_8INCH_GT911
       bool "haobangshou(jiangchuang) 8inch panel 1024600 touchcreen"

config YOUYANG_TUGUAN_10INCH_GT928
       bool "youyang tuguan 10inch panel 1024600 touchcreen"
endchoice
```

## drivers/video/rockchip/screen/Kconfig
```kconfig
choice
	depends on FB_ROCKCHIP
	prompt  "LCD Panel Select"

config LCD_NULL
	bool "NULL"

config LCD_RK2928
	bool "RK2928 LCD"
        depends on MACH_RK2928

config LCD_NWD_10INCH
       bool "nwd 10inch panel 1280x800"

config LCD_NWD_HONGJING1024768
       bool "nwd 1024*768 hongjing"

config LCD_NWD_ZHUOYI_10INCH
       bool "nwd zhuoyi 10inch panel 1280x600"

config LCD_NWD_8INCH
       bool "nwd 8inch panel 1024x600"

config LCD_NWD_YL1024480
       bool "nwd 9inch yinlong panel 1024x480"

config LCD_NWD_QW1024480
       bool "nwd 9inch qiwen panel 1024x480"

config LCD_NWD_QW1280480
       bool "nwd 9inch qiwen panel 1280x480"

config LCD_NWD_HX1024487
       bool "nwd 9inch panel 1024x487"

config LCD_NWD_800480
       bool "nwd 6inch base panel 800x480"

config LCD_NWD_800480_30MHZ
       bool "nwd 6inch base panel 800x480 clock 30Mhz"

config LCD_NWD_800480POL
       bool "nwd 6inch base turn clock pol panel 800x480"

config LCD_RK3168_AUO_A080SN03
       bool "nwd 7inch  panel 800x480(must use t311)"

config LCD_N311_7INCH
       bool "nwd N311_7INCH panel "


config LCD_LG_LP097X02
	bool "RGB LCD_LG_LP097X02 1024X768"

config LCD_TD043MGEA1
	bool "RGB TD043MGEA1"

config LCD_HX8357
	bool "RGB HX8357"	

config LCD_TJ048NC01CA
	bool "RGB TJ048NC01CA"

config LCD_HL070VM4AU
	bool "RGB_HL070VM4AU"

config LCD_HSD070IDW1
	bool "RGB Hannstar800x480"

config LCD_RGB_TFT480800_25_E
	bool "RGB TFT480800_25_E"

config LCD_HSD100PXN
	bool "RGB Hannstar HSD100PXN(1024X768)"

config LCD_BYD8688FTGF
	bool "RGB BYD 1024X600 8688FTGF"

config LCD_B101AW06
	bool "RGB Hannstar B101AW06(1024X600)"

config LCD_RGB_TFT480800_25_E
	bool "RGB TFT480800_25_E(480X800)"

config LCD_LS035Y8DX02A
	bool "RGB LS035Y8DX02A(480X800)"

config LCD_LS035Y8DX04A
	bool "RGB LS035Y8DX04A(480X800)"

config LCD_HSD100PXN_FOR_TDW851
	bool "RGB Hannstar HSD100PXN(800X480)"	

config LCD_CPTCLAA038LA31XE
	bool "RGB LCD_CPTCLAA038LA31XE(480X800)"	  

config LCD_A060SE02
	bool "MCU A060SE02"

config LCD_S1D13521
	bool "MCU S1D13521"

config LCD_NT35582
	bool "MCU NT35582"

config LCD_NT35580
	bool "MCU NT35580"

config LCD_IPS1P5680_V1_E
	bool "MCU IPS1P5680_V1_E"

config LCD_MCU_TFT480800_25_E
	bool "MCU TFT480800_25_E"

config LCD_NT35510
	bool "RGB lcd_nt35510"	

config LCD_ILI9803_CPT4_3
	bool "RGB lcd_ILI9803_CPT4_3"	

config LCD_IPS1P5680_V1_E
	bool "MCU IPS1P5680_V1_E"

config LCD_MCU_TFT480800_25_E
	bool "MCU TFT480800_25_E"

config LCD_AT070TNA2
	bool "RGB AT070TNA2"

config LCD_AT070TN93
	bool "RGB AT070TN93"

config LCD_TX23D88VM
	bool "HITACHI LVDS TX23D88VM (1200x800)"

config LCD_A050VL01
	bool "RGB A050VL01"

config LCD_B101EW05
	bool "RGB lcd  panel B101EW05"

config LCD_RK3168M_B101EW05
	bool "RGB lcd  panel LCD_RK3168M_B101EW05"

config LCD_HJ050NA_06A
	bool "RGB lcd  panel HJ050NA-06A"
	
config LCD_HDMI_1366x768
	bool "RK610 LCD_HDMI_1366X768"
	---help---
	if support RK610, this setting can support dual screen output

config LCD_HDMI_1280x800
	bool "RGB Hannstar LCD_HDMI_1280X800"
	---help---
	if support RK610, this setting can support dual screen output

config LCD_HDMI_1024x768
	bool "RGB Hannstar LCD_HDMI_1024X768"
	---help---
	if support RK610, this setting can support dual screen output

config LCD_HSD07PFW1
        depends on MFD_RK610
        bool "RGB Hannstar LCD_HDMI_1024X600"

config LCD_HDMI_800x480
	bool "RGB Hannstar LCD_HDMI_800x480"
	---help---
	if support RK610, this setting can support dual screen output

config LCD_HV070WSA100
	bool "HV070WSA-100 1024X600"

config LCD_COMMON
	bool "LCD COMMON"



config LCD_RK2928_A720
       bool "RK2928 A720 panel 800x480"

config LCD_RK2926_V86
	bool "RK2926 v86 panel 800x480"

config LCD_RK3168_86V
	bool "RK3168 86v panel 800x480"

config LCD_HJ080NA
	bool "HJ080NA_4J 1024X768"

config LCD_HJ101NA
        bool "HJ101NA_4J 1280X800"

config LCD_AUTO
	bool "auto select lcd"

config LCD_HSD07PFW1
	bool "RGB lcd panel HSD07PFW1"

config LCD_I30_800X480
        bool "lcd I30"

config LCD_TL5001_MIPI
	bool "TL5001 720X1280"

config LCD_LP097QX1
	bool "Display Port screen LP097QX1"

config LCD_DS1006H
	bool "Lvds screen for ds1006h(RK3168)"

config LCD_B101UANO_1920x1200
	bool "Lvds screen B101UANO for u30gt2"

config LCD_E242868_1024X600
	bool "RK3168 86v RGB 1024*600 "
config LCD_E242868_RK616_1024X600
          bool "RK3168 RK616 86v RGB 1024*600 "
config LCD_WY_800X480
	bool "lcd for 760"

config LCD_HH070D_LVDS
	bool "lcd lvds for 760"
config LCD_RK3028_86V
        bool "RGB 1024*600 for RK3028 86V"
config LCD_LD089WU1_MIPI
	bool "mipi dsi lcd LD089WU1 1920X1200"
config LCD_B080XAN02_MIPI
	bool "mipi dsi lcd B080XAN02 1024X768"	
config LCD_RK3168_FAC
        bool "RK3168 for factoryTool"     
endchoice
```

## fs/exfat/Kconfig
```kconfig
config EXFAT_FS
        tristate "EXFAT fs support"
	select NLS_UTF8
        help
          If unsure, say N.
```
